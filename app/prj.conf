## CMakeLists.txt
```
cmake_minimum_required(VERSION 3.20.0)

find_package(Zephyr REQUIRED HINTS $ENV{ZEPHYR_BASE})
project(retroplc_runtime LANGUAGES C CXX)

# Suppress compiler warnings for the PLC runtime.
zephyr_compile_options(-w)

set(STRUCPP_RUNTIME_INCLUDE_DIR
    "${CMAKE_CURRENT_SOURCE_DIR}/src/strucpp-runtime")

target_sources(app PRIVATE
    src/main.cpp
    src/plc_mgmt.cpp
    src/strucpp_fault.cpp
)

target_include_directories(app PRIVATE
    "${STRUCPP_RUNTIME_INCLUDE_DIR}"
)

# The PLC project remains outside the west workspace. The IDE passes its
# generated build directory here; every C++ translation unit in that directory
# becomes part of this central Zephyr application.
set(RETROPLC_GENERATED_DIR "" CACHE PATH
    "Directory containing the C++ output generated by STruCpp")
zephyr_get(RETROPLC_GENERATED_DIR SYSBUILD LOCAL)

if(RETROPLC_GENERATED_DIR)
  if(NOT IS_ABSOLUTE "${RETROPLC_GENERATED_DIR}")
    message(FATAL_ERROR "RETROPLC_GENERATED_DIR must be an absolute path")
  endif()

  file(GLOB RETROPLC_GENERATED_SOURCES CONFIGURE_DEPENDS
      "${RETROPLC_GENERATED_DIR}/*.cpp"
      "${RETROPLC_GENERATED_DIR}/*.cc"
      "${RETROPLC_GENERATED_DIR}/*.cxx")

  file(GLOB RETROPLC_GENERATED_HEADERS CONFIGURE_DEPENDS
      "${RETROPLC_GENERATED_DIR}/*.hpp")

  if(NOT RETROPLC_GENERATED_SOURCES)
    message(FATAL_ERROR
        "No generated C++ sources found in ${RETROPLC_GENERATED_DIR}")
  endif()

  list(LENGTH RETROPLC_GENERATED_HEADERS RETROPLC_GENERATED_HEADER_COUNT)
  if(NOT RETROPLC_GENERATED_HEADER_COUNT EQUAL 1)
    message(FATAL_ERROR
        "Expected exactly one generated .hpp file in ${RETROPLC_GENERATED_DIR}")
  endif()

  list(GET RETROPLC_GENERATED_HEADERS 0 RETROPLC_GENERATED_HEADER)
  get_filename_component(RETROPLC_GENERATED_HEADER_NAME
      "${RETROPLC_GENERATED_HEADER}" NAME)

  set(RETROPLC_CONFIGURATION_CLASS "Configuration_CONFIGURATION1" CACHE STRING
      "Generated STruCpp configuration class to run")

  target_sources(app PRIVATE ${RETROPLC_GENERATED_SOURCES})
  target_include_directories(app PRIVATE "${RETROPLC_GENERATED_DIR}")
  target_compile_definitions(app PRIVATE
      RETROPLC_HAS_GENERATED_PROGRAM=1
      RETROPLC_GENERATED_HEADER=\"${RETROPLC_GENERATED_HEADER_NAME}\"
      RETROPLC_CONFIGURATION_CLASS=${RETROPLC_CONFIGURATION_CLASS}
  )
else()
  message(STATUS
      "RETROPLC_GENERATED_DIR was not supplied; building the platform shell only")
endif()
```

## Kconfig
```
menu "RetroPLC runtime"

config RETROPLC_MGMT_MAX_LOCATED_VARS
	int "Maximum located variables in an MCUmgr scan snapshot"
	range 1 128
	default 64
	help
	  Maximum number of located-variable values captured at the end of each
	  PLC scan and returned by MCUmgr group 64, command 0. The response reports
	  truncation when the generated program contains more entries.

endmenu

source "Kconfig.zephyr"
```

## sysbuild.conf
```
# Build upstream MCUboot together with the RetroPLC application.
SB_CONFIG_BOOTLOADER_MCUBOOT=y

# Uploaded images begin in the second sector of the equal-sized secondary slot.
SB_CONFIG_MCUBOOT_MODE_SWAP_USING_OFFSET=y

# Development configuration: validate image hashes without requiring keys.
SB_CONFIG_BOOT_SIGNATURE_TYPE_NONE=y
```

## prj.conf
```kconfig
# STruCpp emits C++17 and uses standard-library containers and utilities.
CONFIG_CPP=y
CONFIG_STD_CPP17=y
CONFIG_REQUIRES_FULL_LIBCPP=y

# Embedded runtime faults are handled by src/strucpp_fault.cpp.
CONFIG_CPP_EXCEPTIONS=n
CONFIG_CPP_RTTI=n

# Arduino Opta relay and status LED outputs.
CONFIG_GPIO=y

# MCUmgr over the Opta M7 USB CDC-ACM UART. The board devicetree already
# assigns the CDC-ACM device to the zephyr,uart-mcumgr chosen node, so MCUmgr
# can share the USB serial port with the console using SMP-over-console framing.
CONFIG_NET_BUF=y
CONFIG_ZCBOR=y
CONFIG_MCUMGR=y
CONFIG_BASE64=y
CONFIG_CRC=y
CONFIG_UART_MCUMGR=y
CONFIG_MCUMGR_TRANSPORT_UART=y

# Firmware upload to MCUboot's secondary slot.
CONFIG_BOOTLOADER_MCUBOOT=y
CONFIG_FLASH=y
CONFIG_FLASH_MAP=y
CONFIG_STREAM_FLASH=y
CONFIG_IMG_MANAGER=y
CONFIG_MCUMGR_GRP_IMG=y
CONFIG_IMG_ERASE_PROGRESSIVELY=y
CONFIG_IMG_ENABLE_IMAGE_CHECK=y

# MCUmgr OS group
CONFIG_MCUMGR=y
CONFIG_MCUMGR_GRP_OS=y

# echo
CONFIG_MCUMGR_GRP_OS_ECHO=y

# Task/thread statistics
CONFIG_THREAD_MONITOR=y
CONFIG_MCUMGR_GRP_OS_TASKSTAT=y

# Heap statistics
CONFIG_SYS_HEAP_RUNTIME_STATS=y
CONFIG_SYS_HEAP_ARRAY_SIZE=32
CONFIG_MCUMGR_GRP_OS_MPSTAT=y

# Reset
CONFIG_REBOOT=y

# MCUmgr parameters
CONFIG_MCUMGR_GRP_OS_MCUMGR_PARAMS=y
CONFIG_MCUMGR_GRP_IMG_SLOT_INFO=y

# Application / uname-style information
CONFIG_MCUMGR_GRP_OS_INFO=y

# Bootloader information
CONFIG_MCUMGR_GRP_OS_BOOTLOADER_INFO=y

# Increase buffer size for mcumgr smp access
CONFIG_MCUMGR_TRANSPORT_NETBUF_SIZE=4096
CONFIG_MCUMGR_TRANSPORT_UART_MTU=4096
CONFIG_MCUMGR_TRANSPORT_WORKQUEUE_STACK_SIZE=8192
```

## boards/arduino_opta_stm32h747xx_m7.overlay
```dts
/*
 * MCUboot swap-using-offset requires identical erase-sector layouts in both
 * slots. Extend the M7 flash device over both 1 MiB banks and give the M7
 * image pair two equal 512 KiB slots.
 *
 * The final 768 KiB is intentionally left unpartitioned for a future M4 image
 * pair. M4 updating is not enabled yet.
 */
&flash0 {
	reg = <0x08000000 DT_SIZE_M(2)>;
	ranges = <0 0x08000000 DT_SIZE_M(2)>;

	partitions {
		slot1_partition: partition@c0000 {
			compatible = "zephyr,mapped-partition";
			label = "image-1";
			reg = <0x000c0000 DT_SIZE_K(512)>;
		};
	};
};

&slot0_partition {
	reg = <0x00040000 DT_SIZE_K(512)>;
};
```

## src/main.cpp
```c
#ifdef RETROPLC_HAS_GENERATED_PROGRAM
#include RETROPLC_GENERATED_HEADER
#endif

#include "plc_mgmt.hpp"

#include <zephyr/dfu/mcuboot.h>
#include <zephyr/drivers/gpio.h>
#include <zephyr/kernel.h>

#include <errno.h>

#ifdef RETROPLC_HAS_GENERATED_PROGRAM
namespace {

/* %QX0.0 .. %QX0.7: O1-O4 followed by LED1-LED4. */
const gpio_dt_spec digital_outputs[] = {
    GPIO_DT_SPEC_GET(DT_ALIAS(relay1), gpios),
    GPIO_DT_SPEC_GET(DT_ALIAS(relay2), gpios),
    GPIO_DT_SPEC_GET(DT_ALIAS(relay3), gpios),
    GPIO_DT_SPEC_GET(DT_ALIAS(relay4), gpios),
    GPIO_DT_SPEC_GET(DT_ALIAS(led0), gpios),
    GPIO_DT_SPEC_GET(DT_ALIAS(led1), gpios),
    GPIO_DT_SPEC_GET(DT_ALIAS(led2), gpios),
    GPIO_DT_SPEC_GET(DT_ALIAS(led3), gpios),
};

constexpr size_t digital_output_count =
    sizeof(digital_outputs) / sizeof(digital_outputs[0]);

int initialize_digital_outputs() {
  for (const auto &output : digital_outputs) {
    if (!gpio_is_ready_dt(&output)) {
      return -ENODEV;
    }

    const int result = gpio_pin_configure_dt(&output, GPIO_OUTPUT_INACTIVE);
    if (result < 0) {
      return result;
    }
  }

  return 0;
}

int write_located_digital_outputs() {
  for (uint32_t index = 0; index < strucpp::locatedVarsCount; ++index) {
    const strucpp::LocatedVar &located = strucpp::locatedVars[index];

    if (located.area != strucpp::LocatedArea::Output ||
        located.size != strucpp::LocatedSize::Bit || located.byte_index != 0 ||
        located.bit_index >= digital_output_count ||
        located.pointer == nullptr) {
      continue;
    }

    const bool value = *static_cast<const bool *>(located.pointer);
    const int result =
        gpio_pin_set_dt(&digital_outputs[located.bit_index], value);
    if (result < 0) {
      return result;
    }
  }

  return 0;
}

} // namespace
#endif

int main() {
#ifdef RETROPLC_HAS_GENERATED_PROGRAM
  if (initialize_digital_outputs() < 0) {
    return 0;
  }

  static strucpp::RETROPLC_CONFIGURATION_CLASS configuration;
  if (configuration.get_resource_count() == 0) {
    return 0;
  }

  strucpp::ResourceInstance &resource = configuration.get_resources()[0];
  if (resource.task_count == 0 || resource.tasks[0].interval_ns <= 0) {
    return 0;
  }

  strucpp::TaskInstance &task = resource.tasks[0];
  // TODO: Add failed firmware state handling.
  boot_write_img_confirmed();

  while (true) {
    strucpp::__CURRENT_TIME_NS += task.interval_ns;

    for (size_t index = 0; index < task.program_count; ++index) {
      task.programs[index]->run();
    }

    if (write_located_digital_outputs() < 0) {
      return 0;
    }

    plc_mgmt_publish_scan(strucpp::locatedVars, strucpp::locatedVarsCount);

    k_sleep(K_NSEC(task.interval_ns));
  }
#endif

  return 0;
}
```

## src/plc_mgmt.cpp
```c
#include "plc_mgmt.hpp"

#include <zephyr/kernel.h>
#include <zephyr/mgmt/mcumgr/mgmt/handlers.h>
#include <zephyr/mgmt/mcumgr/mgmt/mgmt.h>
#include <zephyr/mgmt/mcumgr/smp/smp.h>
#include <zephyr/sys/atomic.h>
#include <zephyr/sys/util.h>

#include <mgmt/mcumgr/util/zcbor_bulk.h>
#include <zcbor_decode.h>
#include <zcbor_encode.h>

#include <algorithm>
#include <cstdint>
#include <cstdio>
#include <cstring>

namespace {

constexpr uint16_t kPlcMgmtGroupId = MGMT_GROUP_ID_PERUSER;
constexpr uint8_t kSnapshotCommandId = 0;
constexpr uint32_t kDefaultWaitMs = 5000;
constexpr uint32_t kMaximumWaitMs = 30000;
constexpr uint8_t kAfterKey[] = {'a', 'f', 't', 'e', 'r'};
constexpr uint8_t kTimeoutMsKey[] = {'t', 'i', 'm', 'e', 'o',
                                     'u', 't', '_', 'm', 's'};

struct SnapshotValue {
  strucpp::LocatedArea area;
  strucpp::LocatedSize size;
  uint16_t byte_index;
  uint8_t bit_index;
  uint64_t raw_value;
};

struct ScanSnapshot {
  uint32_t generation;
  uint32_t total_count;
  uint32_t value_count;
  SnapshotValue values[CONFIG_RETROPLC_MGMT_MAX_LOCATED_VARS];
};

ScanSnapshot snapshots[2]{};
ScanSnapshot response_snapshot{};
atomic_t published_snapshot = ATOMIC_INIT(0);
atomic_t scan_generation = ATOMIC_INIT(0);
K_MUTEX_DEFINE(snapshot_mutex);
K_SEM_DEFINE(scan_completed, 0, 1);

bool generation_is_after(uint32_t candidate, uint32_t reference) {
  return static_cast<int32_t>(candidate - reference) > 0;
}

uint64_t read_raw_value(const strucpp::LocatedVar &located) {
  if (located.pointer == nullptr) {
    return 0;
  }

  if (located.size == strucpp::LocatedSize::Bit) {
    return *static_cast<const bool *>(located.pointer) ? 1U : 0U;
  }

  uint64_t value = 0;
  const size_t byte_count = located.byte_size();
  if (byte_count != 0 && byte_count <= sizeof(value)) {
    std::memcpy(&value, located.pointer, byte_count);
  }
  return value;
}

void copy_published_snapshot(ScanSnapshot &destination) {
  k_mutex_lock(&snapshot_mutex, K_FOREVER);
  destination =
      snapshots[static_cast<uint32_t>(atomic_get(&published_snapshot)) & 1U];
  k_mutex_unlock(&snapshot_mutex);
}

bool encode_address(zcbor_state_t *zse, const SnapshotValue &value) {
  char address[20];
  int length;

  if (value.size == strucpp::LocatedSize::Bit) {
    length = std::snprintf(address, sizeof(address), "%cX%u.%u",
                           strucpp::area_to_char(value.area), value.byte_index,
                           value.bit_index);
  } else {
    length = std::snprintf(address, sizeof(address), "%c%c%u",
                           strucpp::area_to_char(value.area),
                           strucpp::size_to_char(value.size), value.byte_index);
  }

  return length > 0 && static_cast<size_t>(length) < sizeof(address) &&
         zcbor_tstr_put_term(zse, address, sizeof(address));
}

bool encode_snapshot_value(zcbor_state_t *zse, const SnapshotValue &value) {
  bool ok = zcbor_map_start_encode(zse, 2) &&
            zcbor_tstr_put_lit(zse, "address") && encode_address(zse, value);

  if (value.size == strucpp::LocatedSize::Bit) {
    ok = ok && zcbor_tstr_put_lit(zse, "value") &&
         zcbor_bool_put(zse, value.raw_value != 0);
  } else {
    /* LocatedSize identifies width, not the signed IEC type. Keep the
     * integer representation explicitly raw so the IDE can interpret it. */
    ok = ok && zcbor_tstr_put_lit(zse, "raw") &&
         zcbor_uint64_put(zse, value.raw_value);
  }

  return ok && zcbor_map_end_encode(zse, 2);
}

int snapshot_read(struct smp_streamer *ctxt) {
  zcbor_state_t *zsd = ctxt->reader->zs;
  zcbor_state_t *zse = ctxt->writer->zs;
  uint32_t requested_after = 0;
  uint32_t timeout_ms = kDefaultWaitMs;
  size_t decoded = 0;
  struct zcbor_map_decode_key_val request_decode[] = {
      ZCBOR_MAP_DECODE_KEY_DECODER(kAfterKey, zcbor_uint32_decode,
                                   &requested_after),
      ZCBOR_MAP_DECODE_KEY_DECODER(kTimeoutMsKey, zcbor_uint32_decode,
                                   &timeout_ms),
  };

  if (zcbor_map_decode_bulk(zsd, request_decode, ARRAY_SIZE(request_decode),
                            &decoded) != 0 ||
      timeout_ms > kMaximumWaitMs) {
    return MGMT_ERR_EINVAL;
  }

  const bool after_was_supplied = zcbor_map_decode_bulk_key_found(
      request_decode, ARRAY_SIZE(request_decode), "after");
  if (!after_was_supplied) {
    requested_after = static_cast<uint32_t>(atomic_get(&scan_generation));
  }

  const int64_t deadline = k_uptime_get() + timeout_ms;
  while (!generation_is_after(
      static_cast<uint32_t>(atomic_get(&scan_generation)), requested_after)) {
    const int64_t remaining_ms = deadline - k_uptime_get();
    if (remaining_ms <= 0 ||
        k_sem_take(&scan_completed, K_MSEC(remaining_ms)) == -EAGAIN) {
      break;
    }
  }

  copy_published_snapshot(response_snapshot);
  const bool timed_out =
      !generation_is_after(response_snapshot.generation, requested_after);
  const bool truncated =
      response_snapshot.value_count < response_snapshot.total_count;

  bool ok = zcbor_tstr_put_lit(zse, "scan") &&
            zcbor_uint32_put(zse, response_snapshot.generation) &&
            zcbor_tstr_put_lit(zse, "timed_out") &&
            zcbor_bool_put(zse, timed_out) &&
            zcbor_tstr_put_lit(zse, "total") &&
            zcbor_uint32_put(zse, response_snapshot.total_count) &&
            zcbor_tstr_put_lit(zse, "count") &&
            zcbor_uint32_put(zse, response_snapshot.value_count) &&
            zcbor_tstr_put_lit(zse, "truncated") &&
            zcbor_bool_put(zse, truncated) && zcbor_tstr_put_lit(zse, "vars") &&
            zcbor_list_start_encode(zse, response_snapshot.value_count);

  for (uint32_t index = 0; ok && index < response_snapshot.value_count;
       ++index) {
    ok = encode_snapshot_value(zse, response_snapshot.values[index]);
  }

  ok = ok && zcbor_list_end_encode(zse, response_snapshot.value_count);
  return ok ? MGMT_ERR_EOK : MGMT_ERR_EMSGSIZE;
}

const struct mgmt_handler plc_mgmt_handlers[] = {
    [kSnapshotCommandId] =
        {
            .mh_read = snapshot_read,
            .mh_write = nullptr,
        },
};

struct mgmt_group plc_mgmt_group = {
    .mg_handlers = plc_mgmt_handlers,
    .mg_handlers_count = ARRAY_SIZE(plc_mgmt_handlers),
    .mg_group_id = kPlcMgmtGroupId,
};

void plc_mgmt_register() { mgmt_register_group(&plc_mgmt_group); }

MCUMGR_HANDLER_DEFINE(plc_mgmt, plc_mgmt_register);

} // namespace

void plc_mgmt_publish_scan(const strucpp::LocatedVar *located_vars,
                           uint32_t located_var_count) {
  const uint32_t current_index =
      static_cast<uint32_t>(atomic_get(&published_snapshot)) & 1U;
  const uint32_t next_index = current_index ^ 1U;
  ScanSnapshot &next = snapshots[next_index];

  next.total_count = located_var_count;
  next.value_count = std::min<uint32_t>(located_var_count,
                                        CONFIG_RETROPLC_MGMT_MAX_LOCATED_VARS);
  next.generation = static_cast<uint32_t>(atomic_get(&scan_generation)) + 1U;

  for (uint32_t index = 0; index < next.value_count; ++index) {
    const strucpp::LocatedVar &located = located_vars[index];
    SnapshotValue &value = next.values[index];
    value.area = located.area;
    value.size = located.size;
    value.byte_index = located.byte_index;
    value.bit_index = located.bit_index;
    value.raw_value = read_raw_value(located);
  }

  /* The handler holds this mutex only while copying the already-built
   * snapshot. No CBOR encoding or USB transmission occurs under the lock. */
  k_mutex_lock(&snapshot_mutex, K_FOREVER);
  atomic_set(&published_snapshot, next_index);
  atomic_set(&scan_generation, next.generation);
  k_mutex_unlock(&snapshot_mutex);

  k_sem_give(&scan_completed);
}
```

## src/plc_mgmt.hpp
```c
#pragma once

#include "strucpp-runtime/iec_located.hpp"

#include <cstdint>

/** Capture and publish a coherent end-of-scan snapshot for MCUmgr clients. */
void plc_mgmt_publish_scan(const strucpp::LocatedVar *located_vars,
                           uint32_t located_var_count);
```

## src/strucpp_fault.cpp
```c
#include <zephyr/kernel.h>

#include "iec_fault.hpp"

namespace strucpp {

[[noreturn]] void iec_runtime_fault(IecFault reason, const char *context) noexcept
{
	ARG_UNUSED(reason);
	ARG_UNUSED(context);

	/* A board adapter must force physical outputs safe before production use. */
	k_panic();

	/* Keep the compiler's noreturn analysis valid for all Zephyr configurations. */
	for (;;) {
		k_sleep(K_FOREVER);
	}
}

} // namespace strucpp
```
